## boards/shields/Maple52swt/Kconfig.shield
```kconfig
# Copyright (c) 2020 Pete Johanson
# SPDX-License-Identifier: MIT

config SHIELD_Maple52swt_L
    def_bool $(shields_list_contains,Maple52swt_L)

config SHIELD_Maple52swt_R
    def_bool $(shields_list_contains,Maple52swt_R)
```

## boards/shields/SylvaTwin/Kconfig.defconfig
```kconfig
if SHIELD_Maple52swt_L
    config ZMK_KEYBOARD_NAME
        default "Maple52swt_L"
    
    config ZMK_SPLIT_ROLE_CENTRAL
        default y

    config ZMK_SPLIT_BLE_CENTRAL_PERIPHERALS
        default 1

    config ZMK_SPLIT
        default y
endif

if SHIELD_Maple52swt_R

    config ZMK_KEYBOARD_NAME
        default "Maple52swt_R"
        
    config ZMK_SPLIT
        default y
endif
```

## boards/shields/maple50w/Kconfig.defconfig
```kconfig
if SHIELD_maple50w

    config ZMK_KEYBOARD_NAME
        default "maple50w"
        
endif
```

## boards/shields/maple50w/Kconfig.shield
```kconfig
# Copyright (c) 2020 Pete Johanson
# SPDX-License-Identifier: MIT

config SHIELD_maple50w
    def_bool $(shields_list_contains,maple50w)
```
